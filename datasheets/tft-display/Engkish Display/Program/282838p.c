
//     
/***************************************************/

#include<reg51.h>
#include<absacc.h>
#include<intrins.h>
#include<string.h>
#define uchar unsigned char
#define uint unsigned int

sbit cs        =P3^5;
sbit rs        =P2^3;
sbit sda       =P2^2;
sbit scl       =P2^1;
sbit reset     =P3^4;


sbit ConAdd    =P3^1;
sbit ConSub    =P3^0;
sbit PAUSE     =P3^3;

sbit Type      =P3^5; //0-��Ʒ���,1-���Ʒ���
sbit Mtp       =P3^2;  //MTP Burn


uchar code map1[];
uchar code map2[];

uchar bdata bitdata;
sbit bit7=bitdata^7;
sbit bit6=bitdata^6;
sbit bit5=bitdata^5;
sbit bit4=bitdata^4;
sbit bit3=bitdata^3;
sbit bit2=bitdata^2;
sbit bit1=bitdata^1;
sbit bit0=bitdata^0;

void  OTP_Program();
void  delay(uint t);
void  Contrast_Adjust();
uchar code Zk_ASCII8X16[];

void Display_Desc();
void Output_Pixel(uint x,uint y);
void Display_ASCII8X16(uint x0,uint y0,uchar *s);
void Test_FinshGoods();
void Test_HalfFinshGoods();
void EEPROM_ERASE();
void EEPROM_Writing();

void delay(uint time)
{
 uint i,j;
  for(i=0;i<time;i++)
   for(j=0;j<250;j++);
}

void Pause() interrupt 2
{
    delay(100);
    while(!PAUSE);
    delay(100);
    while(PAUSE);
    delay(100);
    while(!PAUSE);
    delay(100);
}



void LCD_CtrlWrite_IC(uchar c)
{
bitdata=c;
cs=0;
rs=0;
sda=bit7;scl=0;scl=1;
sda=bit6;scl=0;scl=1;
sda=bit5;scl=0;scl=1;
sda=bit4;scl=0;scl=1;
sda=bit3;scl=0;scl=1;
sda=bit2;scl=0;scl=1;
sda=bit1;scl=0;scl=1;
sda=bit0;scl=0;scl=1;
cs=1;


}
void  LCD_DataWrite_IC(uchar d)  
{

bitdata=d;
cs=0;
rs=1;
sda=bit7;scl=0;scl=1;
sda=bit6;scl=0;scl=1;
sda=bit5;scl=0;scl=1;
sda=bit4;scl=0;scl=1;
sda=bit3;scl=0;scl=1;
sda=bit2;scl=0;scl=1;
sda=bit1;scl=0;scl=1;
sda=bit0;scl=0;scl=1;
cs=1;
}

void LCD_DataWrite(uchar LCD_DataH,uchar LCD_DataL)
{
LCD_DataWrite_IC(LCD_DataH);
LCD_DataWrite_IC(LCD_DataL);
}


void  write_command(uchar c)
{
bitdata=c;
cs=0;
rs=0;
sda=bit7;scl=0;scl=1;
sda=bit6;scl=0;scl=1;
sda=bit5;scl=0;scl=1;
sda=bit4;scl=0;scl=1;
sda=bit3;scl=0;scl=1;
sda=bit2;scl=0;scl=1;
sda=bit1;scl=0;scl=1;
sda=bit0;scl=0;scl=1;
cs=1;      
}

void  write_data(uchar d)
{
bitdata=d;
cs=0;
rs=1;
sda=bit7;scl=0;scl=1;
sda=bit6;scl=0;scl=1;
sda=bit5;scl=0;scl=1;
sda=bit4;scl=0;scl=1;
sda=bit3;scl=0;scl=1;
sda=bit2;scl=0;scl=1;
sda=bit1;scl=0;scl=1;
sda=bit0;scl=0;scl=1;
cs=1;
}


void Reset()
{
    reset=0;
    delay(100);
    reset=1;
    delay(100);
}
//////////////////////////////////////////////////////////////////////////////////////////////

void lcd_initial()
{
/*
   reset=0;
   delay(100);
   reset=1;
   delay(100);
  */
//------------------------------------------------------------------//  
//-------------------Software Reset-------------------------------//
//------------------------------------------------------------------//
 write_command(0x01);   //Sofeware setting
  delay(10);
  write_command(0x11);   //sleep out
  delay(120);

    write_command(0x3A); 
    write_data(0x05);  //  18 bit  RGB color  format  select
    delay(10);

   write_command(0xB1);  // Frame rate setting   95hz
   write_data(0x00);
   write_data(0x06);
   write_data(0x03);
    delay(10);

    write_command(0x36);  // MV,MX,MY 
   write_data(0xC8); 

   write_command(0xB6);  // Display control non-overlap
   write_data(0x15); 
   write_data(0x02); 
   
  

   write_command(0xB4);  // line inverion
   write_data(0x00); 

   //POWER ON SETTING 

   write_command(0xC0);    //VCI1=2.65V
   write_data(0x02);
   write_data(0x70);
   delay(10);
   write_command(0xC1);   
   write_data(0X05);  // VGH,VGL
   write_command(0xC2);  
   write_data(0X01);
   write_data(0X02);   // DC/DC SET
   write_command(0xC5); // VCOMH=3.925V;VCOML=0.875V, 
   write_data(0x3C);  
   write_data(0x38);
    delay(10);

   write_command(0xFC); 
   write_data(0x11);
   write_data(0x15);
    //GAMMA SETTING
    
  write_command(0xE0);// Positive
  write_data(0x09);//+1
  write_data(0x16);//+2
  write_data(0x09);//+3
  write_data(0x20);//+4
  write_data(0x21);//+5
  write_data(0x1B);//+6
  write_data(0x13);//+7
  write_data(0x19);//+8
  write_data(0x17);//+9
  write_data(0x15);//+10
  write_data(0x1E);//+11
  write_data(0x2B);//+12
  write_data(0x04);//+13
  write_data(0x05);//+14
  write_data(0x02);//+15
  write_data(0x0E);//+16



  write_command(0xE1);// Negative
  write_data(0x0B);//-1
  write_data(0x14);//-2
  write_data(0x08);//-3
  write_data(0x1E);//-4
  write_data(0x22);//-5
  write_data(0x1D);//-6
  write_data(0x18);//-7
  write_data(0x1E);//-8
  write_data(0x1B);//-9
  write_data(0x1A);//-10
  write_data(0x24);//-11
  write_data(0x2B);//-12
  write_data(0x06);//-13
  write_data(0x06);//-14
  write_data(0x02);//-15
  write_data(0x0F);//-16
  delay(10);

  //window setting
   write_command(0x2A);
   write_data(0x00);
   write_data(0x02);
   write_data(0x00);
   write_data(0x81);
  
   write_command(0x2B);
   write_data(0x00);
   write_data(0x01);
   write_data(0x00);
   write_data(0xA0);

   //write_command(0x26);  // default gamma setting 
   //write_command(0x30);  // partial area setting 
   
    write_command(0x13);
    delay(10);
    
    write_command(0x2C);

    delay(20);

    write_command(0x29);  //display  on setting 

    delay(120);
}



void  RamAdressSet()
{
   write_command(0x2A);
   write_data(0x00);
   write_data(0x02);
   write_data(0x00);
   write_data(0x81);
  
   write_command(0x2B);
   write_data(0x00);
   write_data(0x01);
   write_data(0x00);
   write_data(0xA0);		  
}



void PutPixel(uint x_start,uint y_start,uint color)
{
	LCD_CtrlWrite_IC(0x2a);
	LCD_DataWrite_IC(x_start);
	LCD_DataWrite_IC(0x5f);
	LCD_CtrlWrite_IC(0x2b);
	LCD_DataWrite_IC(y_start+0x34);
	LCD_DataWrite_IC(0x7F);
	LCD_CtrlWrite_IC(0x2c);
	LCD_DataWrite_IC(color>>8);
	LCD_DataWrite_IC(color&0xff);
	
}

void RedLine()
{
	uchar i=0,j=0;
	i=66;   // 11��ҽ�
	for(j=0;j<16;j++)
	{
		PutPixel(i,j,0xf800);
	}

}


void dsp_single_colour(DH,DL)
{
 uchar i,j;
 //RamAdressSet();
 for (i=0;i<160;i++)
    for (j=0;j<128;j++)
        LCD_DataWrite(DH,DL);
}

void Display_Desc()
{ 
    Display_ASCII8X16(1,52,"MD:T18003");
    Display_ASCII8X16(1,64,"Pro:T4528B00");
    Display_ASCII8X16(1,76,"Dots:128*160");
    Display_ASCII8X16(1,88,"IC: ST7735B");
    Display_ASCII8X16(1,100,"VA:6 o'clock");
    Display_ASCII8X16(1,112,"2010.11.26");
}

void Output_Pixel(uint x,uint y)
{
    LCD_CtrlWrite_IC(0x2A);  //Column Address Set        ****
	LCD_DataWrite_IC(x);//xsh 
	LCD_DataWrite_IC(x);//xsl 	
	LCD_CtrlWrite_IC(0x2B);//Row Address Set             ****
	LCD_DataWrite_IC(y);//ysl 
	LCD_DataWrite_IC(y);//ysl 
	LCD_CtrlWrite_IC(0x2c);
	LCD_DataWrite(0xf8,0x00);
    RamAdressSet();

}


void Display_ASCII8X16(uint x0,uint y0,uchar *s)
{
	int i,j,k,x,y,xx;
	
	unsigned char qm;
	
	long int ulOffset;
	
	char  ywbuf[32],temp[2];

	for(i = 0; i<strlen((char*)s);i++)
	{
		if(((unsigned char)(*(s+i))) >= 161)
		{
			temp[0] = *(s+i);
			temp[1] = '\0';
			return;
		}
		
		else
		{
			qm = *(s+i);

			ulOffset = (long int)(qm) * 16;
			
            for (j = 0; j < 16; j ++)
            {
				ywbuf[j]=Zk_ASCII8X16[ulOffset+j];
           	}
             
            for(y = 0;y < 16;y++)
            {
	          	for(x=0;x<8;x++) 
	           	{
                	k=x % 8;
                	
				  	if(ywbuf[y]&(0x80 >> k))
				   	{
				  		xx=x0+x+i*8;
				    	Output_Pixel(xx,y+y0);
				  	}
			   	}
           }

		}
	}     	
}



main()
{
 lcd_initial();

     while(1)
  {
 write_command(0x2C);


    dsp_single_colour(0xff,0xff);
    Display_Desc();         //�汾
    delay(500);	
    }
 }

uchar code Zk_ASCII8X16[]=
 {
  0x00,0x00,0x00,0x00,0x00,0x00,0x00,0x00,0x00,0x00,0x00,0x00,0x00,
  0x00,0x00,0x00,0x00,0x00,0x00,0x00,0x00,0x00,0x00,0x00,0x00,0x00,
  0x00,0x00,0x00,0x00,0x00,0x00,0x00,0x00,0x00,0x00,0x00,0x00,0x00,
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  0x00,0x00 
  };



